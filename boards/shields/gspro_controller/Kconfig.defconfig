## boards/shields/gspro_controller/Kconfig.shield
```kconfig
# Copyright (c) 2020 Pete Johanson, Richard Jones
# SPDX-License-Identifier: MIT

config SIMCADDY_GSPRO
	def_bool $(shields_list_contains,gspro_controller)
```
